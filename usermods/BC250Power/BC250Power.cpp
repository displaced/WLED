#include "wled.h"
#include <atomic>

#ifdef ARDUINO_ARCH_ESP32
#include <driver/gpio.h>
// AI: below section was generated by an AI
// Integration follows usermods/EXAMPLE; behavior follows the personal BC-250 handoff.
class BC250Power : public Usermod {
  private:
    enum class State : uint8_t { Off, Booting, Running, ShuttingDown, Error };
    enum class OsEvent : uint8_t { None, Running, ShuttingDown };
    static const char NAME[];
    static const char KEY_ENABLED[];
    static const char KEY_PIN[];
    static const char KEY_RELAY_ACTIVE_LOW[];
    static const char KEY_BUTTON_ACTIVE_LOW[];
    static const char KEY_SENSE_ACTIVE_HIGH[];
    static const char KEY_AUTOMATIC_CUTOFF[];
    static const char KEY_PULSE_MS[];
    static const char KEY_LONG_PRESS_MS[];
    static const char KEY_FORCE_HOLD_MS[];
    static const char KEY_SENSE_DEBOUNCE_MS[];
    static const char KEY_OFF_GRACE_MS[];
    static const char KEY_BOOT_TIMEOUT_MS[];
    static const char KEY_BOOTING_PRESET[];
    static const char KEY_RUNNING_PRESET[];
    static const char KEY_SHUTDOWN_PRESET[];
    static const char KEY_ERROR_PRESET[];
    static constexpr uint8_t PIN_COUNT = 4;
    static constexpr uint8_t PSU = 0, POWER_BUTTON = 1, CASE_BUTTON = 2, SENSE = 3;
    static constexpr uint32_t DEBOUNCE_MS = 40;
    static constexpr uint32_t EMERGENCY_HOLD_MS = 10000;

    struct Settings {
      bool enabled = false;
      int8_t pins[PIN_COUNT] = {16, 17, 22, 4};
      bool relayActiveLow = false; // Verified on this board by checking COM/NO continuity.
      bool buttonActiveLow = true;
      bool senseActiveHigh = true;
      bool automaticCutoff = false; // Enable only after measuring the shutdown sense signal.
      uint32_t pulseMs = 250;
      uint32_t longPressMs = 2000;
      uint32_t forceHoldMs = 5000;
      uint32_t senseDebounceMs = 100;
      uint32_t offGraceMs = 2000;
      uint32_t bootTimeoutMs = 120000;
      uint8_t presets[4] = {0, 0, 0, 0}; // Booting, running, shutdown, error.
    } saved, active;

    // Config edits are staged until reboot; only loop() owns live GPIO/state changes.
    std::atomic<bool> initialized{false};
    std::atomic<bool> rebootRequired{false};
    std::atomic<bool> configRejected{false};
    std::atomic<OsEvent> pendingEvent{OsEvent::None};
    std::atomic<uint32_t> status{0};
    State state = State::Off;
    bool pinsReady = false, psuOn = false, pulseActive = false;
    bool senseRaw = false, senseOn = false, seenPower = false;
    bool buttonRaw = false, buttonDown = false, buttonArmed = false, pressConsumed = false;
    bool emergencyEligible = false, emergencyOff = false;
    uint32_t senseChangedAt = 0, buttonChangedAt = 0, pressedAt = 0;
    uint32_t bootStartedAt = 0, pulseStartedAt = 0, pulseDuration = 0, senseLostAt = 0;
    uint8_t pendingPreset = 0;

    static const char* stateName(State value) {
      switch (value) {
        case State::Off: return "OFF";
        case State::Booting: return "BOOTING";
        case State::Running: return "RUNNING";
        case State::ShuttingDown: return "SHUTTING_DOWN";
        default: return "ERROR";
      }
    }

    // Pack one coherent snapshot for JSON callbacks running on another task.
    void publishStatus() {
      status.store(uint32_t(state) | (uint32_t(psuOn) << 8) | (uint32_t(pulseActive) << 9)
        | (uint32_t(senseOn) << 10) | (uint32_t(pinsReady) << 11) | (uint32_t(active.enabled) << 12));
    }

    // Preset application is deferred to loop(), never performed in network callbacks.
    void transition(State next) {
      if (state == next) return;
      DEBUG_PRINTF_P(PSTR("BC250Power: %s -> %s\n"), stateName(state), stateName(next));
      state = next;
      pendingPreset = next == State::Off ? 0 : active.presets[uint8_t(next) - 1];
    }

    // Consume once, including initialization errors that prevent GPIO control.
    void applyPendingPreset() {
      if (!pendingPreset) return;
      const uint8_t preset = pendingPreset;
      pendingPreset = 0;
      applyPreset(preset, CALL_MODE_DIRECT_CHANGE);
    }

    // PSU ownership takes precedence over preset/API master power. Keep appearance
    // and remembered brightness intact; recheck because presets load asynchronously.
    void syncLedPower() {
      if ((bri > 0) == psuOn) return;
      toggleOnOff();
      stateUpdated(CALL_MODE_DIRECT_CHANGE);
      DEBUG_PRINTF_P(PSTR("BC250Power: LED power %s (following PSU)\n"), psuOn ? "ON" : "OFF");
    }

    void writeRelay(uint8_t index, bool on) {
      digitalWrite(active.pins[index], on != active.relayActiveLow ? HIGH : LOW);
      DEBUG_PRINTF_P(PSTR("BC250Power: %s relay command %s (GPIO %d)\n"),
        index == PSU ? "PSU" : "board button", on ? "ON" : "OFF", active.pins[index]);
    }

    // Repeated requests cannot extend an existing pulse into an accidental hard shutdown.
    void startPulse(uint32_t now, uint32_t duration) {
      if (!psuOn || pulseActive) return;
      pulseStartedAt = now;
      pulseDuration = duration;
      pulseActive = true;
      writeRelay(POWER_BUTTON, true);
      DEBUG_PRINTF_P(PSTR("BC250Power: button pulse requested for %lu ms\n"), (unsigned long)duration);
    }

    void stopPulse() {
      writeRelay(POWER_BUTTON, false);
      pulseActive = false;
    }

    // A deliberate extended hold overrides even missing/stuck power sense.
    void forcePowerOff() {
      stopPulse();
      writeRelay(PSU, false);
      psuOn = false;
      seenPower = false;
      emergencyOff = true;
      emergencyEligible = false;
      pressConsumed = true;
      pendingEvent.store(OsEvent::None);
      transition(State::Off);
      DEBUG_PRINTLN(F("BC250Power: emergency 10-second hold; PSU forced OFF"));
    }

    // Only a deliberate button press starts power; electrical sense is not OS readiness.
    void startPower(uint32_t now) {
      if (state != State::Off || senseOn) return;
      seenPower = false;
      bootStartedAt = now;
      psuOn = true;
      writeRelay(PSU, true);
      transition(State::Booting);
    }

    // Require a stable input and a previously observed powered state before cutting power.
    void updateSense(uint32_t now) {
      const bool reading = (digitalRead(active.pins[SENSE]) == HIGH) == active.senseActiveHigh;
      if (reading != senseRaw) {
        senseRaw = reading;
        senseChangedAt = now;
      }
      if (senseOn != senseRaw && uint32_t(now - senseChangedAt) >= active.senseDebounceMs) {
        senseOn = senseRaw;
        DEBUG_PRINTF_P(PSTR("BC250Power: power sense %s\n"), senseOn ? "active" : "inactive");
        if (!senseOn) senseLostAt = now;
      }
      if (senseOn && psuOn) seenPower = true;
      if (!senseOn) emergencyOff = false;
      if (senseOn && !psuOn && !emergencyOff) transition(State::Error);
      if (!senseOn && !psuOn && state == State::Error) transition(State::Off);
      if (!psuOn || !seenPower || senseOn) return;
      // Preserve OS state during the grace period so a returning signal cancels cleanly.
      if (active.automaticCutoff && !senseRaw && uint32_t(now - senseChangedAt) >= active.senseDebounceMs
          && uint32_t(now - senseLostAt) >= active.offGraceMs) {
        stopPulse();
        writeRelay(PSU, false);
        psuOn = false;
        seenPower = false;
        transition(State::Off);
      }
    }

    // Short presses act on release; holding the start press never also requests shutdown.
    void updateButton(uint32_t now) {
      const bool reading = (digitalRead(active.pins[CASE_BUTTON]) == LOW) == active.buttonActiveLow;
      if (reading != buttonRaw) {
        buttonRaw = reading;
        buttonChangedAt = now;
      }
      if (buttonDown != buttonRaw && uint32_t(now - buttonChangedAt) >= DEBOUNCE_MS) {
        buttonDown = buttonRaw;
        if (buttonDown && buttonArmed) {
          pressedAt = now;
          emergencyEligible = psuOn; // Never arm from the initial power-on press.
          pressConsumed = state == State::Off;
          if (pressConsumed) startPower(now);
        } else if (!buttonDown) {
          if (buttonArmed && !pressConsumed && psuOn) startPulse(now, active.pulseMs);
          buttonArmed = true;
          pressConsumed = false;
          emergencyEligible = false;
        }
      }
      // Ignore a button held during controller boot until it has been released.
      if (!buttonDown && !buttonRaw) buttonArmed = true;
      // Check before the ordinary long hold, including when the loop was delayed.
      // A sampled release cancels cutoff immediately, before release debounce finishes.
      if (buttonArmed && buttonDown && buttonRaw && emergencyEligible && psuOn
          && uint32_t(now - pressedAt) >= EMERGENCY_HOLD_MS) {
        forcePowerOff();
        return;
      }
      if (buttonArmed && buttonDown && !pressConsumed && uint32_t(now - pressedAt) >= active.longPressMs) {
        pressConsumed = true;
        startPulse(now, active.forceHoldMs);
        if (psuOn) transition(State::ShuttingDown);
      }
    }

    // Reject malformed/out-of-range values before narrowing to GPIO, timing or preset types.
    template<typename T>
    bool readNumber(JsonVariant value, T& target, int32_t minimum, int32_t maximum) {
      if (value.isNull()) return false;
      if (!value.is<int32_t>()) {
        configRejected.store(true);
        return false;
      }
      const int32_t number = value.as<int32_t>();
      if (number < minimum || number > maximum) {
        configRejected.store(true);
        return false;
      }
      target = T(number);
      return true;
    }

    bool readBool(JsonVariant value, bool& target) {
      if (value.isNull()) return false;
      if (!value.is<bool>()) {
        configRejected.store(true);
        return false;
      }
      target = value.as<bool>();
      return true;
    }

  public:
    // Allocate all pins atomically before touching hardware; retain reservations when disabled.
    void setup() override {
      active = saved;
      managed_pin_type pins[PIN_COUNT];
      bool valid = !configRejected.load();
      for (uint8_t i = 0; i < PIN_COUNT; i++) {
        pins[i] = {active.pins[i], i < CASE_BUTTON};
        valid &= active.pins[i] >= 0 && PinManager::isPinOk(active.pins[i], i < CASE_BUTTON);
        for (uint8_t j = 0; j < i; j++) valid &= active.pins[i] != active.pins[j];
      }
      pinsReady = valid && PinManager::allocateMultiplePins(pins, PIN_COUNT, PinOwner::UM_BC250Power);
      if (!pinsReady) {
        transition(State::Error);
        DEBUG_PRINTLN(F("BC250Power: invalid or conflicting pins; controller inactive"));
      } else {
        // Preload inactive levels before enabling output drivers; reset bias is board-dependent.
        for (uint8_t i = 0; i < CASE_BUTTON; i++) {
          // Use the IDF latch API: Arduino 3 digitalWrite requires prior pinMode registration.
          gpio_set_level(gpio_num_t(active.pins[i]), active.relayActiveLow ? 1 : 0);
          pinMode(active.pins[i], OUTPUT);
          writeRelay(i, false);
        }
        pinMode(active.pins[CASE_BUTTON], active.buttonActiveLow ? INPUT_PULLUP : INPUT_PULLDOWN);
        pinMode(active.pins[SENSE], active.senseActiveHigh ? INPUT_PULLDOWN : INPUT_PULLUP);
        buttonRaw = buttonDown = (digitalRead(active.pins[CASE_BUTTON]) == LOW) == active.buttonActiveLow;
        buttonArmed = !buttonDown;
        pressConsumed = buttonDown;
        senseRaw = senseOn = (digitalRead(active.pins[SENSE]) == HIGH) == active.senseActiveHigh;
        senseChangedAt = buttonChangedAt = millis();
        if (senseOn) transition(State::Error);
      }
      publishStatus();
      DEBUG_PRINTF_P(PSTR("BC250Power: setup complete; pins=%s, control=%s, automatic cutoff=%s\n"),
        pinsReady ? "ready" : "ERROR", active.enabled ? "enabled" : "disabled", active.automaticCutoff ? "enabled" : "disabled");
      initialized.store(true);
    }

    // Unsigned elapsed times remain valid across millis() wraparound; no blocking waits.
    void loop() override {
      if (!pinsReady) {
        if (active.enabled) applyPendingPreset();
        return;
      }
      const uint32_t now = millis();
      if (pulseActive && uint32_t(now - pulseStartedAt) >= pulseDuration) stopPulse();
      updateSense(now);
      if (!active.enabled) {
        publishStatus();
        return;
      }
      const OsEvent event = pendingEvent.exchange(OsEvent::None);
      if (psuOn && senseOn && senseRaw) {
        if (event == OsEvent::Running && (state == State::Booting || state == State::Error)) transition(State::Running);
        if (event == OsEvent::ShuttingDown) transition(State::ShuttingDown);
      }
      updateButton(now);
      if (state == State::Booting && uint32_t(now - bootStartedAt) >= active.bootTimeoutMs) {
        // Missing OS readiness is an error, never justification to remove main power.
        transition(State::Error);
      }
      publishStatus();
      applyPendingPreset();
      syncLedPower();
    }

    // Commands are separate from reported state so saved lighting presets cannot replay them.
    void readFromJsonState(JsonObject& root) override {
      if (!initialized.load() || !active.enabled || !pinsReady) return;
      JsonVariant event = root[FPSTR(NAME)]["osEvent"];
      if (!event.is<const char*>()) return;
      const char* text = event.as<const char*>();
      if (strncmp(text, "running", sizeof("running")) == 0) pendingEvent.store(OsEvent::Running);
      else if (strncmp(text, "shutting_down", sizeof("shutting_down")) == 0) pendingEvent.store(OsEvent::ShuttingDown);
    }

    // Only observations are serialized, never commands or live configuration changes.
    void addToJsonState(JsonObject& root) override {
      const uint32_t snapshot = status.load();
      JsonObject top = root.createNestedObject(FPSTR(NAME));
      top["state"] = stateName(State(snapshot & 0xFF));
      top["psuOn"] = bool(snapshot & (1U << 8));
      top["buttonRelayOn"] = bool(snapshot & (1U << 9));
      top["powerSense"] = bool(snapshot & (1U << 10));
      top["pinsReady"] = bool(snapshot & (1U << 11));
      top[FPSTR(KEY_ENABLED)] = bool(snapshot & (1U << 12));
      top["rebootRequired"] = rebootRequired.load();
      top["configRejected"] = configRejected.load();
    }

    void addToJsonInfo(JsonObject& root) override {
      JsonObject user = root["u"];
      if (user.isNull()) user = root.createNestedObject("u");
      JsonArray info = user.createNestedArray(FPSTR(NAME));
      info.add(stateName(State(status.load() & 0xFF)));
    }

    // WLED builds the Usermod Settings form from these persistent fields.
    void addToConfig(JsonObject& root) override {
      JsonObject top = root.createNestedObject(FPSTR(NAME));
      top[FPSTR(KEY_ENABLED)] = saved.enabled;
      JsonArray pins = top.createNestedArray(FPSTR(KEY_PIN));
      for (uint8_t i = 0; i < PIN_COUNT; i++) pins.add(saved.pins[i]);
      top[FPSTR(KEY_RELAY_ACTIVE_LOW)] = saved.relayActiveLow;
      top[FPSTR(KEY_BUTTON_ACTIVE_LOW)] = saved.buttonActiveLow;
      top[FPSTR(KEY_SENSE_ACTIVE_HIGH)] = saved.senseActiveHigh;
      top[FPSTR(KEY_AUTOMATIC_CUTOFF)] = saved.automaticCutoff;
      top[FPSTR(KEY_PULSE_MS)] = saved.pulseMs;
      top[FPSTR(KEY_LONG_PRESS_MS)] = saved.longPressMs;
      top[FPSTR(KEY_FORCE_HOLD_MS)] = saved.forceHoldMs;
      top[FPSTR(KEY_SENSE_DEBOUNCE_MS)] = saved.senseDebounceMs;
      top[FPSTR(KEY_OFF_GRACE_MS)] = saved.offGraceMs;
      top[FPSTR(KEY_BOOT_TIMEOUT_MS)] = saved.bootTimeoutMs;
      top[FPSTR(KEY_BOOTING_PRESET)] = saved.presets[0];
      top[FPSTR(KEY_RUNNING_PRESET)] = saved.presets[1];
      top[FPSTR(KEY_SHUTDOWN_PRESET)] = saved.presets[2];
      top[FPSTR(KEY_ERROR_PRESET)] = saved.presets[3];
    }

    // Stage settings until reboot to avoid dropping PS_ON during a settings save.
    bool readFromConfig(JsonObject& root) override {
      JsonObject top = root[FPSTR(NAME)];
      if (top.isNull()) return false;
      Settings candidate = saved;
      configRejected.store(false);
      bool complete = true;
      complete &= readBool(top[FPSTR(KEY_ENABLED)], candidate.enabled);
      if (!top[FPSTR(KEY_PIN)].isNull() && (!top[FPSTR(KEY_PIN)].is<JsonArray>() || top[FPSTR(KEY_PIN)].size() != PIN_COUNT)) configRejected.store(true);
      for (uint8_t i = 0; i < PIN_COUNT; i++) complete &= readNumber(top[FPSTR(KEY_PIN)][i], candidate.pins[i], -1, WLED_NUM_PINS - 1);
      complete &= readBool(top[FPSTR(KEY_RELAY_ACTIVE_LOW)], candidate.relayActiveLow);
      complete &= readBool(top[FPSTR(KEY_BUTTON_ACTIVE_LOW)], candidate.buttonActiveLow);
      complete &= readBool(top[FPSTR(KEY_SENSE_ACTIVE_HIGH)], candidate.senseActiveHigh);
      complete &= readBool(top[FPSTR(KEY_AUTOMATIC_CUTOFF)], candidate.automaticCutoff);
      complete &= readNumber(top[FPSTR(KEY_PULSE_MS)], candidate.pulseMs, 50, 1000);
      complete &= readNumber(top[FPSTR(KEY_LONG_PRESS_MS)], candidate.longPressMs, 1000, 10000);
      complete &= readNumber(top[FPSTR(KEY_FORCE_HOLD_MS)], candidate.forceHoldMs, 3000, 15000);
      complete &= readNumber(top[FPSTR(KEY_SENSE_DEBOUNCE_MS)], candidate.senseDebounceMs, 20, 2000);
      complete &= readNumber(top[FPSTR(KEY_OFF_GRACE_MS)], candidate.offGraceMs, 100, 60000);
      complete &= readNumber(top[FPSTR(KEY_BOOT_TIMEOUT_MS)], candidate.bootTimeoutMs, 5000, 600000);
      complete &= readNumber(top[FPSTR(KEY_BOOTING_PRESET)], candidate.presets[0], 0, 250);
      complete &= readNumber(top[FPSTR(KEY_RUNNING_PRESET)], candidate.presets[1], 0, 250);
      complete &= readNumber(top[FPSTR(KEY_SHUTDOWN_PRESET)], candidate.presets[2], 0, 250);
      complete &= readNumber(top[FPSTR(KEY_ERROR_PRESET)], candidate.presets[3], 0, 250);
      // Reject the entire edit, including enable/polarity, if any supplied value is malformed.
      if (configRejected.load()) return false;
      saved = candidate;
      if (initialized.load()) rebootRequired.store(true);
      return complete;
    }

    void appendConfigData() override {
      oappend(F("addInfo('BC250Power:enabled',1,'Changes require reboot; shut down the BC-250 first.');"));
      oappend(F("addInfo('BC250Power:pin[]',0,'PSU relay');"));
      oappend(F("addInfo('BC250Power:pin[]',1,'Board-button relay');"));
      oappend(F("addInfo('BC250Power:pin[]',2,'Case button');"));
      oappend(F("addInfo('BC250Power:pin[]',3,'Power sense');"));
      oappend(F("addInfo('BC250Power:automatic-cutoff',1,'Enable only after verifying sense goes inactive at shutdown with PSU still on.');"));
      oappend(F("addInfo('BC250Power:booting-preset',1,'0 keeps appearance; LED master power follows PSU.');"));
    }

    uint16_t getId() override { return USERMOD_ID_BC250_POWER; }
};

const char BC250Power::NAME[] PROGMEM = "BC250Power";
const char BC250Power::KEY_ENABLED[] PROGMEM = "enabled";
const char BC250Power::KEY_PIN[] PROGMEM = "pin";
const char BC250Power::KEY_RELAY_ACTIVE_LOW[] PROGMEM = "relay-active-low";
const char BC250Power::KEY_BUTTON_ACTIVE_LOW[] PROGMEM = "button-active-low";
const char BC250Power::KEY_SENSE_ACTIVE_HIGH[] PROGMEM = "sense-active-high";
const char BC250Power::KEY_AUTOMATIC_CUTOFF[] PROGMEM = "automatic-cutoff";
const char BC250Power::KEY_PULSE_MS[] PROGMEM = "pulse-ms";
const char BC250Power::KEY_LONG_PRESS_MS[] PROGMEM = "long-press-ms";
const char BC250Power::KEY_FORCE_HOLD_MS[] PROGMEM = "force-hold-ms";
const char BC250Power::KEY_SENSE_DEBOUNCE_MS[] PROGMEM = "sense-debounce-ms";
const char BC250Power::KEY_OFF_GRACE_MS[] PROGMEM = "off-grace-ms";
const char BC250Power::KEY_BOOT_TIMEOUT_MS[] PROGMEM = "boot-timeout-ms";
const char BC250Power::KEY_BOOTING_PRESET[] PROGMEM = "booting-preset";
const char BC250Power::KEY_RUNNING_PRESET[] PROGMEM = "running-preset";
const char BC250Power::KEY_SHUTDOWN_PRESET[] PROGMEM = "shutdown-preset";
const char BC250Power::KEY_ERROR_PRESET[] PROGMEM = "error-preset";
static BC250Power bc250Power;
REGISTER_USERMOD(bc250Power);
// AI: end
#endif
