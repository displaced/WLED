#pragma once
#include "wled.h"
#include "ControllerLearning.h"
#include <esp32-hal-bt.h>
#include <esp_bt.h>
#include <esp_idf_version.h>
#include <nimble/nimble_port.h>
#include <nimble/nimble_port_freertos.h>
#include <host/ble_hs.h>
#include <host/ble_gap.h>
#if ESP_IDF_VERSION_MAJOR < 5
#include <esp_nimble_hci.h>
#endif
#include <atomic>

// AI: below section was generated by an AI
// Bundled NimBLE observer API: https://docs.espressif.com/projects/esp-idf/en/v4.4.8/esp32/api-reference/bluetooth/nimble/index.html
// No pairing or connections: the controller remains paired to its normal host.
class ControllerScanner {
  using Identity = ControllerLearning::Identity;
  using Store = ControllerLearning::Store;
  using Phase = ControllerLearning::Phase;
  static constexpr size_t QUEUE_SIZE = 32;
  // BLE shares the radio with Wi-Fi. Accept slower wake detection to request
  // only 10 ms of passive reception per 200 ms (5% nominal scan duty cycle).
  // https://docs.espressif.com/projects/esp-idf/en/stable/esp32/api-guides/coexist.html
  static constexpr uint16_t SCAN_INTERVAL = 320; // Units of 0.625 ms.
  static constexpr uint16_t SCAN_WINDOW = 16;
  struct Observation { Identity id; uint32_t at; int rssi; };
  struct Data {
    Store store;
    ControllerLearning::Learner learner;
    bool enabled = false, scanning = false;
    uint32_t revision = esp_random(); // Stale controls also expire across reboot.
    const char* message = "Scanning disabled";
  } data;
  SemaphoreHandle_t mutex = xSemaphoreCreateMutex();
  QueueHandle_t observations = nullptr;
  std::atomic<bool> dropped{false}, dirty{false};
  bool attempted = false, radioReady = false;
  bool present[ControllerLearning::MAX_CONTROLLERS]{};
  uint32_t lastSeen[ControllerLearning::MAX_CONTROLLERS]{};
  uint32_t inhibitedAt = 0;
  uint32_t scanAttemptAt = 0;
  bool inhibited = true, previouslyPowered = false;

  // Only short RAM operations use this lock; radio startup and HTML creation do not.
  bool lock() { return mutex && xSemaphoreTake(mutex, pdMS_TO_TICKS(20)) == pdTRUE; }
  void unlock() { xSemaphoreGive(mutex); }
  bool snapshot(Data& result) {
    if (!lock()) return false;
    result = data;
    unlock();
    return true;
  }
  static int hex(char c) {
    if (c >= '0' && c <= '9') return c - '0';
    if (c >= 'a' && c <= 'f') return c - 'a' + 10;
    if (c >= 'A' && c <= 'F') return c - 'A' + 10;
    return -1;
  }
  // Canonical address text avoids depending on the BLE library's byte ordering.
  static bool parseAddress(const char* text, Identity& id) {
    if (!text || strnlen(text, 18) != 17) return false;
    for (size_t i = 0; i < 6; i++) {
      int high = hex(text[i * 3]), low = hex(text[i * 3 + 1]);
      if (high < 0 || low < 0 || (i < 5 && text[i * 3 + 2] != ':')) return false;
      id.address[i] = uint8_t(high * 16 + low);
    }
    return true;
  }
  static String address(const Identity& id) {
    char text[18];
    snprintf(text, sizeof(text), "%02x:%02x:%02x:%02x:%02x:%02x", id.address[0], id.address[1], id.address[2], id.address[3], id.address[4], id.address[5]);
    return String(text);
  }
  static const char* phaseName(Phase phase) {
    switch (phase) {
      case Phase::Baseline: return "Keep controller OFF (5 seconds)";
      case Phase::Search: return "Turn controller ON normally (30-second search)";
      case Phase::Confirm: return "Select your controller below (60 seconds)";
      default: return "Idle";
    }
  }
  // Names are validated ASCII; ampersands still need escaping in HTML text.
  static String label(const char* name) {
    String text(name);
    text.replace("&", "&amp;");
    text.replace("<", "&lt;");
    text.replace(">", "&gt;");
    text.replace("\"", "&quot;");
    text.replace("'", "&#39;");
    return text;
  }
  // Only fixed actions and numeric values enter JavaScript. Names come from prompt
  // at runtime and are transmitted as JSON, never interpolated into source code.
  static String button(const char* title, const char* action, uint32_t revision, int slot = -1, bool name = false) {
    String html;
    html.reserve(420);
    html = F("<button class=\"btn\" style=\"width:auto;height:auto;margin:2px;font-size:14px\" onclick=\"");
    if (name) html += F("let n=prompt('Controller name (1-24 ASCII characters)');if(!n)return;");
    html += F("requestJson({BC250Power:{controller:{action:'");
    html += action;
    html += F("',revision:"); html += revision;
    if (slot >= 0) { html += F(",slot:"); html += slot + 1; }
    if (name) html += F(",name:n");
    html += F("}}});setTimeout(()=>requestJson(),400);");
    if (!strcmp(action, "learn")) html += F("setTimeout(()=>requestJson(),5500);setTimeout(()=>requestJson(),35500);");
    html += F("\">");
    html += title;
    html += F("</button>");
    return html;
  }

public:
  // Retain only classified packets, with fixed queue bounds. Never touch WLED or
  // learner state from the NimBLE host task.
  static int gapEvent(ble_gap_event* event, void* context) {
    auto* self = static_cast<ControllerScanner*>(context);
    if (event->type != BLE_GAP_EVENT_DISC || !self->observations) return 0;
    const auto& packet = event->disc;
    if (!ControllerLearning::isMicrosoftGamepad(packet.data, packet.length_data) || packet.addr.type > 1) return 0;
    Observation observation{};
    observation.id.type = packet.addr.type;
    // NimBLE stores addresses least-significant octet first; our shared identity
    // is in printed order, matching the prototype and configuration addresses.
    for (size_t i = 0; i < 6; i++) observation.id.address[i] = packet.addr.val[5 - i];
    observation.at = millis(); observation.rssi = packet.rssi;
    if (xQueueSend(self->observations, &observation, 0) != pdTRUE) self->dropped.store(true);
    return 0;
  }
  static void hostTask(void*) {
    nimble_port_run();
    nimble_port_freertos_deinit();
  }

  // Called by WLED's main loop. Radio startup is deferred until the user opts in.
  // Return only a startup request; the power controller applies its own guards.
  bool loop(uint32_t now, bool powered, bool allowInit) {
    bool enabled;
    if (!lock()) return false;
    enabled = data.enabled;
    unlock();
    if (dirty.exchange(false)) configNeedsWrite = true;
    const bool shouldScan = enabled && !powered;
    if (shouldScan && !attempted && allowInit) {
      attempted = true;
      observations = xQueueCreate(QUEUE_SIZE, sizeof(Observation));
      // Calling btStarted also retains Arduino's Bluetooth memory at link time.
      // Never take over a radio already initialized by another usermod.
      if (observations && !btStarted() && esp_bt_controller_get_status() == ESP_BT_CONTROLLER_STATUS_IDLE) {
#if ESP_IDF_VERSION_MAJOR < 5
        if (esp_nimble_hci_and_controller_init() == ESP_OK) {
          nimble_port_init();
          radioReady = true;
        }
#else
        radioReady = nimble_port_init() == ESP_OK;
#endif
        if (radioReady) nimble_port_freertos_init(hostTask);
      }
    }
    bool scanning = false;
    if (radioReady && ble_hs_synced()) {
      if (shouldScan && !ble_gap_disc_active() && uint32_t(now - scanAttemptAt) >= 5000) {
        scanAttemptAt = now;
        uint8_t addressType;
        if (ble_hs_id_infer_auto(0, &addressType) == 0) {
          ble_gap_disc_params parameters{};
          parameters.passive = 1;
          parameters.itvl = SCAN_INTERVAL;
          parameters.window = SCAN_WINDOW;
          parameters.filter_duplicates = 0;
          ble_gap_disc(addressType, BLE_HS_FOREVER, &parameters, gapEvent, this);
        }
      }
      if (!shouldScan && ble_gap_disc_active()) ble_gap_disc_cancel();
      scanning = ble_gap_disc_active();
    }
    if (!lock()) return false;
    now = millis(); // Radio initialization can take time; do not use its old timestamp.
    if (data.scanning != scanning) {
      inhibited = true; inhibitedAt = now;
      data.message = scanning ? "Scanner ready" : "Scanning disabled";
      DEBUG_PRINTF_P(PSTR("BC250Power: controller scanning %s\n"), scanning ? "started" : "stopped");
    }
    data.scanning = scanning;
    // Stop learning as well as reception while the PSU is on. Keep the user's
    // enable setting so scanning resumes automatically after PSU shutdown.
    if (powered && data.learner.phase != Phase::Idle) {
      data.learner.cancel();
      data.revision++;
    }
    if (enabled && powered) data.message = "Scanning paused while PSU is on";
    else if (enabled && !scanning) data.message = "Scanner unavailable; disable and reboot before retrying";
    if (previouslyPowered && !powered) { inhibited = true; inhibitedAt = now; }
    previouslyPowered = powered;
    if (inhibited && uint32_t(now - inhibitedAt) >= ControllerLearning::ABSENCE_MS) inhibited = false;
    if (dropped.exchange(false)) {
      data.learner.cancel();
      data.message = "Packets lost; learning cancelled. Try again.";
      data.revision++;
      inhibited = true; inhibitedAt = now;
    }
    const Phase before = data.learner.phase;
    data.learner.tick(now);
    if (before != Phase::Idle && data.learner.phase == Phase::Idle) data.message = "Learning timed out; nothing saved";
    bool wake = false;
    Observation observation;
    // Bound work per WLED loop so a busy radio cannot starve relay pulse handling.
    for (size_t n = 0; observations && n < QUEUE_SIZE && xQueueReceive(observations, &observation, 0) == pdTRUE; n++) {
      if (powered || !data.enabled || !scanning || uint32_t(now - observation.at) > 1000) continue;
      // Discard packets queued before the current learning phase began.
      if (data.learner.phase != Phase::Idle && uint32_t(observation.at - data.learner.since) < 0x80000000UL)
        data.learner.observe(observation.id, observation.rssi, observation.at, data.store);
      const int slot = ControllerLearning::find(data.store, observation.id);
      if (slot < 0) continue;
      if (present[slot] && uint32_t(observation.at - lastSeen[slot]) >= ControllerLearning::ABSENCE_MS) present[slot] = false;
      if (!present[slot] && data.store.entries[slot].enabled && data.learner.phase == Phase::Idle && !inhibited) {
        wake = true;
        DEBUG_PRINTF_P(PSTR("BC250Power: learned controller %d detected\n"), slot + 1);
      }
      present[slot] = true;
      lastSeen[slot] = observation.at;
    }
    if (data.learner.overflow) data.message = "Too many candidates; learning cancelled";
    unlock();
    return wake && !powered;
  }

  // All edits are atomic under a short lock. A revision prevents an old browser
  // button from modifying a different controller that later occupied the slot.
  void command(JsonObject object) {
    if (object.isNull() || !lock()) return;
    const char* action = object["action"] | "";
    bool changed = false;
    data.message = "Invalid or stale command; refresh and try again";
    if (!object["revision"].is<uint32_t>() || object["revision"].as<uint32_t>() != data.revision) { unlock(); return; }
    int slot = -1;
    if (object["slot"].is<int>()) {
      const int value = object["slot"].as<int>();
      if (value >= 1 && value <= int(ControllerLearning::MAX_CONTROLLERS)) slot = value - 1;
    }
    const char* name = object["name"] | "";
    if (!strcmp(action, "learn") && data.scanning && data.learner.phase == Phase::Idle && ControllerLearning::freeSlot(data.store) >= 0) {
      data.learner.start(millis()); data.revision++; data.message = "Learning started";
    } else if (!strcmp(action, "cancel")) {
      data.learner.cancel(); data.revision++; data.message = "Learning cancelled";
    } else if (!strcmp(action, "scanOn") || !strcmp(action, "scanOff")) {
      data.enabled = !strcmp(action, "scanOn");
      data.learner.cancel(); changed = true;
    } else if (!strcmp(action, "save") && slot >= 0 && slot < int(ControllerLearning::MAX_CANDIDATES)) {
      changed = data.learner.select(slot, name, data.store);
      if (changed) data.learner.cancel();
    } else if (slot >= 0 && slot < int(ControllerLearning::MAX_CONTROLLERS) && data.store.entries[slot].used) {
      auto& entry = data.store.entries[slot];
      if (!strcmp(action, "delete")) { entry = ControllerLearning::Entry{}; changed = true; }
      else if (!strcmp(action, "enable") || !strcmp(action, "disable")) { entry.enabled = !strcmp(action, "enable"); changed = true; }
      else if (!strcmp(action, "rename") && ControllerLearning::validName(name)) { strlcpy(entry.name, name, sizeof(entry.name)); changed = true; }
    }
    if (changed) {
      data.revision++;
      data.message = "Updated; configuration save queued";
      dirty.store(true);
      // Saving/enabling/reconfiguring is never itself a power-on event.
      inhibited = true; inhibitedAt = millis();
      for (size_t i = 0; i < ControllerLearning::MAX_CONTROLLERS; i++) { present[i] = true; lastSeen[i] = inhibitedAt; }
    }
    unlock();
  }

  // WLED only supports numeric arrays in settings forms. One nested object per
  // slot preserves string and boolean types through its existing form parser.
  void addConfig(JsonObject top) {
    Data copy;
    if (!snapshot(copy)) return;
    top["controller-scan"] = copy.enabled;
    for (size_t i = 0; i < ControllerLearning::MAX_CONTROLLERS; i++) {
      const auto& entry = copy.store.entries[i];
      JsonObject item = top.createNestedObject(String("controller") + (i + 1));
      item["address"] = entry.used ? address(entry.id) : String();
      // ArduinoJson retains const char* by address; copy the temporary snapshot's name.
      item["type"] = entry.id.type; item["name"] = String(entry.name);
      item["enabled"] = bool(entry.enabled);
    }
  }

  // Missing fields preserve old installations. Reject partial or malformed slots.
  bool readConfig(JsonObject top) {
    if (!lock()) return false;
    Store candidate = data.store;
    bool enabled = data.enabled;
    bool valid = true;
    if (top.containsKey("controller-scan")) {
      valid = top["controller-scan"].is<bool>(); enabled = top["controller-scan"].as<bool>();
    }
    for (size_t i = 0; valid && i < ControllerLearning::MAX_CONTROLLERS; i++) {
      String key = String("controller") + (i + 1);
      if (!top.containsKey(key)) continue;
      if (!top[key].is<JsonObject>()) { valid = false; break; }
      JsonObject item = top[key];
      auto& entry = candidate.entries[i]; entry = ControllerLearning::Entry{};
      JsonVariant a = item["address"], t = item["type"], n = item["name"], e = item["enabled"];
      if (!a.is<const char*>() || !t.is<int>() || !n.is<const char*>() || !e.is<bool>()) { valid = false; break; }
      const char* text = a.as<const char*>();
      int type = t.as<int>();
      if (type < 0 || type > 1) { valid = false; break; }
      if (!text[0]) continue;
      if (!parseAddress(text, entry.id) || !ControllerLearning::validName(n.as<const char*>())) { valid = false; break; }
      entry.used = 1; entry.enabled = e.as<bool>(); entry.id.type = uint8_t(type);
      strlcpy(entry.name, n.as<const char*>(), sizeof(entry.name));
    }
    valid &= ControllerLearning::validStore(candidate);
    if (valid) {
      data.store = candidate; data.enabled = enabled; data.revision++;
      data.learner.cancel(); inhibited = true; inhibitedAt = millis();
      for (size_t i = 0; i < ControllerLearning::MAX_CONTROLLERS; i++) { present[i] = true; lastSeen[i] = inhibitedAt; }
    }
    unlock();
    return valid;
  }

  // Structured observations contain no replayable commands (safe in presets).
  void addState(JsonObject top) {
    Data copy;
    if (!snapshot(copy)) return;
    JsonObject state = top.createNestedObject("controllers");
    state["enabled"] = copy.enabled; state["scanning"] = copy.scanning;
    state["revision"] = copy.revision; state["phase"] = uint8_t(copy.learner.phase);
    state["message"] = copy.message;
#ifdef BC250_CORE_DIAGNOSTICS
    // Bench-only task-affinity observations; absent tasks are reported as -1.
    JsonObject cores = state.createNestedObject("taskCores");
    // This pinned IDF 4.4 SDK names its NimBLE host task "ble".
    for (const char* name : {"wifi", "btController", "ble"}) {
      TaskHandle_t task = xTaskGetHandle(name);
      cores[name] = task ? int(xTaskGetAffinity(task)) : -1;
    }
#endif
    JsonArray entries = state.createNestedArray("entries");
    for (size_t i = 0; i < ControllerLearning::MAX_CONTROLLERS; i++) {
      const auto& entry = copy.store.entries[i]; if (!entry.used) continue;
      JsonObject item = entries.createNestedObject(); item["slot"] = i + 1;
      item["address"] = address(entry.id); item["type"] = entry.id.type;
      item["name"] = String(entry.name); item["enabled"] = bool(entry.enabled);
    }
    JsonArray candidates = state.createNestedArray("candidates");
    for (size_t i = 0; i < copy.learner.candidateCount; i++) {
      const auto& candidate = copy.learner.candidates[i];
      JsonObject item = candidates.createNestedObject(); item["slot"] = i + 1;
      item["address"] = address(candidate.id); item["type"] = candidate.id.type;
      item["rssi"] = candidate.rssi; item["ready"] = candidate.ready();
    }
  }

  // Info-panel controls use the existing WLED requestJson path, with no core edits.
  void addInfo(JsonObject user) {
    Data copy;
    if (!snapshot(copy)) return;
    String html; html.reserve(900);
    html = copy.scanning ? F("Scanning. ") : F("Not scanning. ");
    html += button(copy.enabled ? "Stop scanning" : "Start scanning", copy.enabled ? "scanOff" : "scanOn", copy.revision);
    if (copy.scanning && copy.learner.phase == Phase::Idle && ControllerLearning::freeSlot(copy.store) >= 0)
      html += button("Learn", "learn", copy.revision);
    if (copy.learner.phase != Phase::Idle) html += button("Cancel", "cancel", copy.revision);
    html += F("<button class=\"btn\" style=\"width:auto;height:auto;margin:2px;font-size:14px\" onclick=\"requestJson();\">Refresh</button><br>");
    html += phaseName(copy.learner.phase); html += F("<br>"); html += copy.message;
    user.createNestedArray("Xbox learning").add(html);
    for (size_t i = 0; i < copy.learner.candidateCount; i++) {
      const auto& candidate = copy.learner.candidates[i];
      html = address(candidate.id); html += F(" / "); html += candidate.rssi; html += F(" dBm ");
      if (candidate.ready() && copy.learner.phase == Phase::Confirm) html += button("Save", "save", copy.revision, i, true);
      else html += F("Waiting for search to finish");
      user.createNestedArray(String("Candidate ") + (i + 1)).add(html);
    }
    for (size_t i = 0; i < ControllerLearning::MAX_CONTROLLERS; i++) {
      const auto& entry = copy.store.entries[i]; if (!entry.used) continue;
      html = label(entry.name); html += F("<br>"); html += address(entry.id); html += F("<br>");
      html += button(entry.enabled ? "Disable" : "Enable", entry.enabled ? "disable" : "enable", copy.revision, i);
      html += button("Rename", "rename", copy.revision, i, true);
      html += button("Delete", "delete", copy.revision, i);
      user.createNestedArray(String("Controller ") + (i + 1)).add(html);
    }
  }
};
// AI: end
