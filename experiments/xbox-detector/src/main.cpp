// AI: below section was generated by an AI
// Passive BLE observation uses Espressif's GAP scan API:
// https://docs.espressif.com/projects/esp-idf/en/v4.4.8/esp32/api-reference/bluetooth/esp_gap_ble.html
#include <Arduino.h>
#include <Preferences.h>
#include "ControllerLearning.h"
#include "LearningTests.h"
#include <atomic>
#include <esp_bt.h>
#include <esp_bt_main.h>
#include <esp_gap_ble_api.h>

// Raw GAP calls bypass Arduino's Bluetooth wrappers. Override the core's weak
// hook so initArduino() retains Bluetooth memory before setup() runs.
extern "C" bool btInUse() { return true; }

// Queue observations so the Bluetooth task never prints or accesses settings.
struct Observation {
  uint8_t address[6];
  uint8_t addressType;
  int rssi;
  uint8_t length;
  uint8_t payload[62];
};
QueueHandle_t observations;
Preferences preferences;
using namespace ControllerLearning;
Store controllers;
Learner learner;
String legacyTarget;
String command;
bool commandOverflow = false;
bool storageReady = false;
uint32_t lastSeen[MAX_CONTROLLERS]{};
bool present[MAX_CONTROLLERS]{};
std::atomic<int> scanStatus{0};
std::atomic<uint32_t> dropped{0};
uint32_t learningDrops = 0;

// Start continuous passive scanning; no scan requests, connections or pairing.
void gapCallback(esp_gap_ble_cb_event_t event, esp_ble_gap_cb_param_t* parameter) {
  if (event == ESP_GAP_BLE_SCAN_PARAM_SET_COMPLETE_EVT) {
    if (parameter->scan_param_cmpl.status != ESP_BT_STATUS_SUCCESS || esp_ble_gap_start_scanning(0) != ESP_OK) scanStatus.store(-1);
  } else if (event == ESP_GAP_BLE_SCAN_START_COMPLETE_EVT) {
    scanStatus.store(parameter->scan_start_cmpl.status == ESP_BT_STATUS_SUCCESS ? 1 : -1);
  } else if (event == ESP_GAP_BLE_SCAN_RESULT_EVT && parameter->scan_rst.search_evt == ESP_GAP_SEARCH_INQ_RES_EVT) {
    Observation observation{};
    memcpy(observation.address, parameter->scan_rst.bda, 6);
    observation.addressType = parameter->scan_rst.ble_addr_type;
    observation.rssi = parameter->scan_rst.rssi;
    observation.length = min(unsigned(sizeof(observation.payload)),
      unsigned(parameter->scan_rst.adv_data_len + parameter->scan_rst.scan_rsp_len));
    memcpy(observation.payload, parameter->scan_rst.ble_adv, observation.length);
    if (xQueueSend(observations, &observation, 0) != pdTRUE) dropped.fetch_add(1);
  }
}

// Formatting is bounded and serial output never runs on the Bluetooth task.
void formatIdentity(const Identity& id, char (&text)[18]) {
  snprintf(text, sizeof(text), "%02x:%02x:%02x:%02x:%02x:%02x", id.address[0],
    id.address[1], id.address[2], id.address[3], id.address[4], id.address[5]);
}
void listControllers() {
  Serial.println("Learned controllers (slot | enabled | address | type | name):");
  for (size_t i = 0; i < MAX_CONTROLLERS; i++) {
    const Entry& entry = controllers.entries[i];
    if (!entry.used) continue;
    char address[18]; formatIdentity(entry.id, address);
    Serial.printf("%u | %s | %s | %u | %s\n", unsigned(i + 1), entry.enabled ? "yes" : "no", address, entry.id.type, entry.name);
  }
  if (legacyTarget.length()) Serial.printf("Legacy target awaiting classified advertisement: %s\n", legacyTarget.c_str());
}
void listCandidates() {
  Serial.println("Candidates (only ready entries can be saved after the search ends):");
  for (size_t i = 0; i < learner.candidateCount; i++) {
    const Candidate& candidate = learner.candidates[i];
    char address[18]; formatIdentity(candidate.id, address);
    Serial.printf("%u | %s | type=%u | packets=%u | RSSI=%d | %s\n", unsigned(i + 1), address,
      candidate.id.type, candidate.count, candidate.rssi, candidate.ready() ? "ready" : "insufficient observations");
  }
}
// One NVS blob commits the complete list; RAM changes only after successful write.
bool commitStore(const Store& next) {
  if (!storageReady || !validStore(next) || preferences.putBytes("controllers", &next, sizeof(next)) != sizeof(next)) {
    Serial.println("ERROR saving list; existing in-memory configuration retained.");
    return false;
  }
  // Editing names or enable flags must not fabricate new appearance events.
  // Newly saved candidates are already observed, so suppress detection on save.
  for (size_t i = 0; i < MAX_CONTROLLERS; i++) {
    if (!next.entries[i].used) present[i] = false;
    else if (!controllers.entries[i].used || !(controllers.entries[i].id == next.entries[i].id)) {
      present[i] = true;
      lastSeen[i] = millis();
    }
  }
  controllers = next;
  return true;
}
// Parse a strictly numeric one-based slot/candidate, rejecting trailing junk.
int parseIndex(const String& value) {
  if (value.length() != 1 || value[0] < '1' || value[0] > '8') return -1;
  return value[0] - '1';
}
void printHelp() {
  Serial.println("Commands: learn | candidates | save <candidate> <name> | cancel | list | status");
  Serial.println("rename <slot> <name> | enable <slot> | disable <slot> | delete <slot> | selftest");
  Serial.println("Learn: controller OFF before command; wait for POWER ON prompt. No pairing.");
}
// Only the serial loop mutates learning/storage; network/UI adapters can later
// queue these same operations for a WLED usermod loop.
void handleCommand() {
  command.trim();
  int split = command.indexOf(' ');
  String verb = split < 0 ? command : command.substring(0, split);
  String arguments = split < 0 ? String() : command.substring(split + 1);
  verb.toLowerCase(); arguments.trim();
  int second = arguments.indexOf(' ');
  String token = second < 0 ? arguments : arguments.substring(0, second);
  String name = second < 0 ? String() : arguments.substring(second + 1);
  name.trim();
  int index = parseIndex(token);
  if (verb == "learn" && arguments.isEmpty()) {
    if (!storageReady) Serial.println("ERROR: storage unavailable; learning disabled.");
    else if (learner.phase != Phase::Idle) Serial.println("Learning already active; cancel first.");
    else if (freeSlot(controllers) < 0) Serial.println("List full (8); delete a controller first.");
    else {
      xQueueReset(observations); // Do not count stale queued packets in the baseline.
      learningDrops = dropped.load();
      learner.start(millis());
      Serial.println("BASELINE: keep controller OFF for 5 seconds.");
    }
  } else if (verb == "cancel" && arguments.isEmpty()) {
    learner.cancel(); Serial.println("Learning cancelled; saved list unchanged.");
  } else if (verb == "candidates" && arguments.isEmpty()) listCandidates();
  else if (verb == "list" && arguments.isEmpty()) listControllers();
  else if (verb == "status" && arguments.isEmpty()) {
    Serial.printf("Learning phase=%u (0 idle, 1 baseline, 2 search, 3 confirm); dropped packets=%lu\n",
      unsigned(learner.phase), (unsigned long)dropped.load());
    listControllers();
  } else if (verb == "selftest" && arguments.isEmpty()) runLearningTests();
  else if (verb == "save") {
    Store next = controllers;
    if (index < 0 || !learner.select(index, name.c_str(), next)) Serial.println("Save rejected: need confirm phase, ready candidate, unique identity, free slot and valid name.");
    else if (commitStore(next)) { learner.cancel(); Serial.println("Controller saved."); listControllers(); }
  } else if (verb == "rename" || verb == "enable" || verb == "disable" || verb == "delete") {
    if (index < 0 || !controllers.entries[index].used || (verb != "rename" && second >= 0)
        || (verb == "rename" && !validName(name.c_str()))) Serial.println("Invalid slot or name (1-24 printable characters, no quotes or angle brackets).");
    else {
      Store next = controllers;
      Entry& entry = next.entries[index];
      if (verb == "delete") entry = Entry{};
      else if (verb == "rename") { memset(entry.name, 0, sizeof(entry.name)); memcpy(entry.name, name.c_str(), name.length()); }
      else entry.enabled = verb == "enable";
      if (commitStore(next)) { Serial.println("List updated."); listControllers(); }
    }
  } else printHelp();
  command = "";
}

// Fail visibly if the selected ESP32 board/framework cannot initialize BLE.
void requireSuccess(esp_err_t result, const char* operation) {
  if (result == ESP_OK) return;
  Serial.printf("ERROR %s: %s\n", operation, esp_err_to_name(result));
  while (true) delay(1000);
}

void setup() {
  Serial.begin(115200);
  delay(500);
  Serial.println("\nXbox detection experiment: passive BLE, no pairing, no relay outputs.");
  storageReady = preferences.begin("xbox-detector", false);
  if (storageReady && preferences.isKey("controllers")) {
    Store loaded{};
    if (preferences.getBytesLength("controllers") != sizeof(loaded)
        || preferences.getBytes("controllers", &loaded, sizeof(loaded)) != sizeof(loaded) || !validStore(loaded)) {
      storageReady = false;
      Serial.println("ERROR: invalid saved list; storage writes disabled to preserve it.");
    } else controllers = loaded;
  } else if (storageReady && preferences.isKey("target")) {
    legacyTarget = preferences.getString("target", "");
    legacyTarget.toLowerCase();
  }
  printHelp();
  listControllers();
  observations = xQueueCreate(32, sizeof(Observation));
  if (!observations) { Serial.println("ERROR: queue allocation"); while (true) delay(1000); }
  requireSuccess(esp_bt_controller_mem_release(ESP_BT_MODE_CLASSIC_BT), "release Classic memory");
  esp_bt_controller_config_t controller = BT_CONTROLLER_INIT_CONFIG_DEFAULT();
  controller.mode = ESP_BT_MODE_BLE;
  requireSuccess(esp_bt_controller_init(&controller), "controller init");
  requireSuccess(esp_bt_controller_enable(ESP_BT_MODE_BLE), "controller enable");
  requireSuccess(esp_bluedroid_init(), "Bluedroid init");
  requireSuccess(esp_bluedroid_enable(), "Bluedroid enable");
  requireSuccess(esp_ble_gap_register_callback(gapCallback), "GAP callback");
  static esp_ble_scan_params_t scan{};
  scan.scan_type = BLE_SCAN_TYPE_PASSIVE;
  scan.own_addr_type = BLE_ADDR_TYPE_PUBLIC;
  scan.scan_filter_policy = BLE_SCAN_FILTER_ALLOW_ALL;
  scan.scan_interval = 0x50;
  scan.scan_window = 0x50;
  scan.scan_duplicate = BLE_SCAN_DUPLICATE_DISABLE;
  requireSuccess(esp_ble_gap_set_scan_params(&scan), "scan parameters");
}

// Detection remains a test event. Learning suppresses events for all saved
// controllers, including while waiting for confirmation.
void loop() {
  int scanEvent = scanStatus.exchange(0);
  if (scanEvent) Serial.println(scanEvent > 0 ? "Passive BLE scan running." : "ERROR: BLE scan did not start; restart and check board/framework.");
  while (Serial.available()) {
    char next = Serial.read();
    if (next == '\n') {
      if (commandOverflow) { Serial.println("Command too long; discarded."); command = ""; }
      else handleCommand();
      commandOverflow = false;
    } else if (command.length() < 80) command += next;
    else commandOverflow = true;
  }
  uint32_t now = millis();
  if (learner.phase != Phase::Idle && dropped.load() != learningDrops) {
    learner.cancel();
    Serial.println("Learning aborted: scan queue overflow; retry in a quieter environment.");
  }
  Phase previous = learner.phase;
  learner.tick(now);
  if (previous != learner.phase) {
    if (learner.phase == Phase::Search) Serial.println("POWER ON controller normally now. Searching for 30 seconds.");
    else if (learner.phase == Phase::Confirm) {
      listCandidates();
      Serial.println("CONFIRM: save <candidate> <name> within 60 seconds, or cancel. Nothing saved automatically.");
    } else Serial.println("Learning expired; saved list unchanged.");
  }
  Observation observation;
  if (xQueueReceive(observations, &observation, pdMS_TO_TICKS(10)) == pdTRUE
      && observation.addressType <= 1 && isMicrosoftGamepad(observation.payload, observation.length)) {
    Identity id{};
    memcpy(id.address, observation.address, sizeof(id.address));
    id.type = observation.addressType;
    char address[18]; formatIdentity(id, address);
    // Preserve the old prototype's target only after the strict filter confirms
    // it and supplies its observed address type. This is migration, not learning.
    if (legacyTarget == address && learner.phase == Phase::Idle) {
      Store next = controllers;
      int slot = freeSlot(next);
      if (slot >= 0 && find(next, id) < 0) {
        next.entries[slot].used = next.entries[slot].enabled = 1;
        next.entries[slot].id = id;
        memcpy(next.entries[slot].name, "Original controller", sizeof("Original controller"));
        if (commitStore(next)) {
          legacyTarget = "";
          preferences.remove("target");
          Serial.println("Migrated original target after gamepad classification.");
        } else {
          legacyTarget = ""; // Keep the NVS key, but do not retry writes on every packet.
          Serial.println("Legacy migration deferred until restart after storage failure.");
        }
      }
    }
    Phase before = learner.phase;
    size_t count = learner.candidateCount;
    learner.observe(id, observation.rssi, now, controllers);
    if (before != Phase::Idle && learner.overflow) Serial.println("Learning aborted: too many candidates/baseline devices; saved list unchanged.");
    if (learner.candidateCount > count) Serial.printf("Candidate %u: %s type=%u (Microsoft gamepad + HID)\n", unsigned(learner.candidateCount), address, id.type);
    int slot = find(controllers, id);
    if (slot >= 0) {
      if (!present[slot] && controllers.entries[slot].enabled && learner.phase == Phase::Idle)
        Serial.printf("DETECTED slot=%u name=%s address=%s (test event only)\n", unsigned(slot + 1), controllers.entries[slot].name, address);
      lastSeen[slot] = now;
      present[slot] = true;
    }
  }
  for (size_t i = 0; i < MAX_CONTROLLERS; i++) {
    if (present[i] && uint32_t(now - lastSeen[i]) >= ABSENCE_MS) {
      present[i] = false;
      Serial.printf("QUIET slot=%u; rearmed (not proof of power-off).\n", unsigned(i + 1));
    }
  }
}
// AI: end
