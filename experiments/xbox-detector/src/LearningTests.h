// AI: below section was generated by an AI
#pragma once
#include "ControllerLearning.h"

// Run against isolated RAM objects on the ESP: no Bluetooth, NVS or GPIO effects.
// The packet is the actual advertisement captured from the model 1914 controller.
inline void runLearningTests() {
  using namespace ControllerLearning;
  unsigned tests = 0, failed = 0;
  auto check = [&](bool passed, const char* label) {
    tests++;
    if (!passed) { failed++; Serial.printf("FAIL: %s\n", label); }
  };
  uint8_t packet[] = {2,1,4,2,10,20,3,25,196,3,4,255,6,0,0,3,3,18,24};
  check(isMicrosoftGamepad(packet, sizeof(packet)), "captured Xbox advertisement");
  check(!isMicrosoftGamepad(packet, sizeof(packet)-1), "truncated final field rejected");
  check(!isMicrosoftGamepad(packet, 10), "gamepad without manufacturer and HID rejected");
  packet[8] = 193;
  check(!isMicrosoftGamepad(packet, sizeof(packet)), "Microsoft keyboard rejected");
  packet[8] = 196; packet[12] = 76;
  check(!isMicrosoftGamepad(packet, sizeof(packet)), "non-Microsoft gamepad rejected");
  packet[12] = 6; packet[17] = 15;
  check(!isMicrosoftGamepad(packet, sizeof(packet)), "non-HID service rejected");
  packet[17] = 18;
  uint8_t bad[] = {255, 25, 196, 3};
  check(!isMicrosoftGamepad(bad, sizeof(bad)), "oversize advertising field rejected");
  check(!validName("") && !validName("<script>") && !validName("1234567890123456789012345"), "label bounds and markup rejected");

  Store store;
  Learner learning;
  Identity existing{}; existing.address[0] = 1;
  Identity first{}; first.address[0] = 2;
  Identity second{}; second.address[0] = 3;
  learning.start(0);
  learning.observe(existing, -40, 10, store);
  learning.tick(BASELINE_MS);
  check(learning.phase == Phase::Search, "baseline timer");
  learning.observe(existing, -30, 5100, store);
  check(learning.candidateCount == 0, "baseline device excluded");
  learning.observe(first, -60, 5200, store);
  learning.observe(first, -60, 5300, store);
  check(!learning.candidates[0].ready(), "two observations insufficient");
  learning.observe(first, -60, 5400, store);
  check(learning.candidates[0].ready(), "three spaced observations sufficient");
  learning.observe(second, -40, 5500, store);
  learning.observe(second, -40, 5700, store);
  learning.observe(second, -40, 5900, store);
  check(learning.candidateCount == 2, "two independent candidates");
  check(!learning.select(0, "First", store), "cannot save during search");
  learning.tick(BASELINE_MS + SEARCH_MS);
  check(learning.phase == Phase::Confirm && freeSlot(store) == 0, "no automatic saving");
  check(learning.select(0, "First", store) && learning.select(1, "Second", store), "multiple controllers saved");
  check(!learning.select(0, "Duplicate", store), "duplicate rejected");
  Identity otherType = first; otherType.type = 1;
  check(find(store, otherType) < 0, "address type is part of identity");
  check(validStore(store), "valid persisted list");
  Store corrupt = store; corrupt.entries[1].id = first;
  check(!validStore(corrupt), "duplicate persisted identity rejected");
  learning.tick(BASELINE_MS + SEARCH_MS + CONFIRM_MS);
  check(learning.phase == Phase::Idle && find(store, first) == 0, "expiry preserves saved controllers");
  learning.start(0); learning.cancel();
  check(learning.phase == Phase::Idle && find(store, second) == 1, "cancel preserves list");
  learning.start(UINT32_MAX - 2000);
  learning.tick(2999);
  check(learning.phase == Phase::Search, "timer rollover");
  learning.start(0);
  for (size_t i = 0; i <= MAX_BASELINE; i++) {
    Identity id{}; id.address[0] = 20 + i;
    learning.observe(id, -40, 0, store);
  }
  check(learning.phase == Phase::Idle && learning.overflow, "baseline overflow aborts");
  learning.start(0); learning.tick(BASELINE_MS);
  for (size_t i = 0; i <= MAX_CANDIDATES; i++) {
    Identity id{}; id.address[0] = 20 + i;
    learning.observe(id, -40, 5100, store);
  }
  check(learning.phase == Phase::Idle && learning.overflow, "candidate overflow aborts");
  for (size_t i = 0; i < MAX_CONTROLLERS; i++) store.entries[i].used = 1;
  check(freeSlot(store) < 0, "full list");
  Serial.printf("SELFTEST: %u/%u passed; %u failed (no settings changed).\n", tests - failed, tests, failed);
}
// AI: end
